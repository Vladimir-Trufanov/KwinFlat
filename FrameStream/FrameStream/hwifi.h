/** Arduino, ESP32, C/C++ ***************************************** hwifi.h ***
 * 
 *                                          Обеспечить работу, связанную с wifi
 *                                                     
 * v1.1.1, 23.02.2026                                 Автор:      Труфанов В.Е.
 * Copyright © 2026 tve                               Дата создания: 24.01.2026
**/

#pragma once   

#include "WiFi.h"
#include <WiFiMulti.h>
WiFiMulti jMulti;
WiFiEventId_t eventID;      
#include "ESPmDNS.h"
#include "esp_wifi.h" 

// ****************************************************************************
// *       Подключить локальные WiFi и создать одну свою от контроллера       *
// ****************************************************************************
bool init_wifi() 
{
  // Устанавливаем режим работы WiFi, как станции (STA). В этом режиме контроллер 
  // не создаёт собственную сеть, а подключается к уже существующей сети WiFi, 
  // например, к локальной сети (роутеру или иному «раздающему» устройству). 
  //
  // В режиме STA ESP32 действует как другое клиентское устройство в сети (например, ноутбук или смартфон). 
  // Его основная цель — обнаружить и подключиться к точке доступа (AP) с помощью SSID (имени сети) и пароля (обычно Pre-Shared Key или PSK). 
  // После подключения ESP32 получает IP-адрес от AP (обычно через DHCP от роутера) 
  // и может общаться с другими устройствами в локальной сети и, если AP предоставляет это, получать доступ в интернет.
  //
  // Важно: подключение к Wi-Fi не является мгновенным, поэтому необходимо регулярно проверять статус соединения 
  // с помощью функции WiFi.status(). После успешного подключения функция возвращает WL_CONNECTED. 
  WiFi.mode(WIFI_STA);
  
  // Настраиваем имя, которое клиент DHCP использует для идентификации устройства
  // (в типичной сетевой настройке это имя отображается в списке устройств маршрутизатора Wi-Fi.
  // По умолчанию имя ESP32 — «espressif». С помощью этой функции можно изменить стандартное имя, 
  // например, для дифференциации устройств в режиме мягкого доступа к точке доступа. 
  // Аргумент - это строка, которая содержит новое имя. Она должна быть не длиннее 
  // 32 символов, содержать только буквы, цифры и символ «-»). 

  // Важно: функцию нужно вызвать до начала Wi-Fi с помощью WiFi.begin(), WiFi.softAP(), 
  // WiFi.mode() или WiFi.run(). Чтобы изменить имя, можно сбросить Wi-Fi с помощью WiFi.mode(WIFI_MODE_NULL), 
  // затем вызвать WiFi.setHostname() и перезагрузить Wi-Fi с нуля. 
  // Если hostname не указан, будет назначено стандартное имя на основе типа чипа и MAC-адреса. 
  WiFi.setHostname(devname);
  // Резервируем место для параметров входа локальной сети
  char ssidch1[20]; char passch1[20];
  // Заполняем параметры для WiFi сети и показываем их
  ssid.toCharArray(ssidch1, ssid.length() + 1);
  pass.toCharArray(passch1, pass.length() + 1);
  say("\n>>>>>>>>>>>>>>>>>>>>>%s<\n", ssidch1);
  // Подключаемся к локальной сетим
  jMulti.addAP(ssidch1, passch1);
  jMulti.run();
  
   // Выбираем и показываем Mac-адрес WiFi
  String wifiMacString = WiFi.macAddress();
  Serial.println("Mac-адрес точки доступа: "+wifiMacString);

  const char _localIP[] = "  Локальный IP: ";
  sayln("Контроллер подключается к локальной точке доступа");
  // Инициируем нулевую попытку подключения
  int connAttempts = 0;
  Serial.println(" ");
  while (WiFi.status() != WL_CONNECTED ) 
  {
    delay(1000);
    Serial.print(".");
    if (connAttempts++ == 15) break;   
  }
  sprintf(localip,"%s",WiFi.localIP().toString().c_str());
  Serial.print(_localIP); Serial.println(localip); 
  
  Serial.println(" ");
  sayln("Определяется местное время");
  // configTime(0, 0, "pool.ntp.org");
  configTime(10800, 0, "ntp.msk-ix.ru");
  char tzchar[60];
  TIMEZONE.toCharArray(tzchar, TIMEZONE.length() + 1);        // name of your camera for mDNS, Router, and filenames
  Serial.printf("Char >%s<\n", tzchar);
  setenv("TZ", tzchar, 1);  // mountain time zone from #define at top
  tzset();
  time(&now);
  // try for 15 seconds to get the time, then give up - 10 seconds after boot
  while (now < 5) 
  {        
    delay(1000);
    Serial.print("o");
    time(&now);
  }
  Serial.print("Местное время: "); Serial.print(ctime(&now));

  // Запускаем службу multicast DNS (mDNS). Это позволяет использовать имя хоста 
  // в веб-браузере вместо IP-адреса при доступе к ESP32 с компьютера. 
  // Особенности работы: динамическая обработка IP-адресов — даже если IP-адрес 
  // устройства изменится, mDNS автоматически преобразует новый IP-адрес в то же имя хоста;
  // нулевая настройка — дополнительная настройка DNS не требуется, поскольку mDNS 
  // работает автономно в локальных сетях; автоматическое добавление суффикса — 
  // если имя хоста уже существует в локальной сети, библиотека автоматически добавляет суффикс. 
  // Например, если esp32.local уже существует, она переименовывает его в esp32-2.local. 
  //
  // В коде ESP32 функция MDNS.begin() вызывается в функции setup() после подключения к сети. 
  // В качестве аргумента метода передаётся желаемое имя хоста. Например, если IP-адрес устройства
  // — 192.168.4.1, можно получить доступ к нему с помощью «esp32.local в веб-браузере. 
  // Важно: имя хоста не должно быть длиннее 63 символов. 
  // 
  // Некоторые ошибки, которые могут возникать при использовании функции MDNS.begin, и способы их решения:
  // а) mDNS не запущен в коде — если MDNS.begin() не вызван или помещён перед подключением к Wi-Fi, сервис не будет рекламироваться. 
  // Решение: инициализировать mDNS после успешного подключения, поместив MDNS.begin("esp32") 
  // внутри события подключения к Wi-Fi;
  // б) Firewall или антивирус блокируют mDNS — в системах без встроенной поддержки mDNS 
  // (Linux, Windows) правила брандмауэра могут препятствовать входящим ответам mDNS 
  // на порт 5353. Решение: проверить правила брандмауэра и, если нужно, изменить их;
  // в) сеть не позволяет многоадресный трафик — некоторые режимы AP, горячие точки или
  // гостевые сети Wi-Fi изолируют клиентов и блокируют многоадресный трафик, включая mDNS. 
  // Решение: проверить политики сети и, если нужно, изменить их.
  if (!MDNS.begin(devname)) 
  {
    sayln("Ошибка при запуске multicast DNS (mDNS)");
  } 
  else 
  {
    sayln("multicast DNS (mDNS) стартовал с именем '%s'", devname);
  }

  eventID = WiFi.onEvent([](WiFiEvent_t event, WiFiEventInfo_t info) 
  {
    //  info.disconnected.reason ==>  info.wifi_sta_disconnected.reason - update with esp32_arduino 2.00 v58
    if (info.wifi_sta_disconnected.reason != 201) 
    {
      //say( "\nframe_cnt: %8d, WiFi event Reason: %d , Status: %d\n", frame_cnt, info.wifi_sta_disconnected.reason, WiFi.status());
    }
  });

  // Отключаем режим энергосбережения: 
  // esp_wifi_get_ps — функция из API драйвера Wi-Fi для платы ESP32, которая получает 
  // режим энергосбережения (sleep mode) Wi-Fi. 
  // Функция входит в класс WiFi и возвращает значение типа wifi_ps_type_t. 
  // Режим энергосбережения WiFi влияет на скорость соединения. Можно установить один из трёх режимов: 
  // WIFI_PS_NONE — режим отключён; WIFI_PS_MIN_MODEM — минимальное энергосбережение; WIFI_PS_MAX_MODEM — максимальное энергосбережение.
  // Функция позволяет системе автоматически просыпаться из сна, когда это требуется драйвером Wi-Fi, 
  // и поддерживать соединение с точкой доступа (AP). 
  // Функция esp_wifi_get_ps вызывается в коде приложения, когда нужно получить текущий 
  // режим энергосбережения Wi-Fi. Например, в функции, которая управляет работой Wi-Fi, 
  // можно вызвать WiFi.getSleep() — она вернёт значение типа wifi_ps_type_t.
  // Важно: режим энергосбережения влияет на то, как драйвер Wi-Fi обрабатывает 
  // пакеты данных — при включённом режиме энергосбережения полученные данные могут 
  // быть задержаны на период, указанный в настройках DTIM. 
  wifi_ps_type_t the_type;
  esp_err_t get_ps = esp_wifi_get_ps(&the_type);
  Serial.printf("Начальный режим энергосбережения: %d\n", the_type);
  esp_err_t set_ps = esp_wifi_set_ps(WIFI_PS_NONE);
  esp_err_t new_ps = esp_wifi_get_ps(&the_type);
  Serial.printf("-Текущий- режим энергосбережения: %d\n", the_type);
  //WRITE_PERI_REG(RTC_CNTL_BROWN_OUT_REG, brown_reg_temp);
  return true;
}


// **************************************************************** hwifi.h ***
